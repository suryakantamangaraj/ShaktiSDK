## software/benchmarking/zephyr-rtos/dts/bindings/serial/shakti,uart0.yaml
```yaml
#
# Copyright (c) 2018, SiFive Inc.
#
# SPDX-License-Identifier: Apache-2.0
#
---
title: SHAKTI UART
version: 0.1

description: >
    This binding gives a base representation of the shakti UART

inherits:
    !include uart.yaml

properties:
    compatible:
      type: string
      category: required
      description: compatible strings
      constraint: "shakti,uart0"
      generation: define

    reg:
      type: array
      description: mmio register space
      generation: define
      category: required

    interrupts:
      type: array
      category: required
      description: required interrupts
      generation: define

...
```
